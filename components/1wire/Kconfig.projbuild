## components/1wire/Kconfig.projbuild
```kconfig
menu "UMNI 1-WIRE"
    config UMNI_ONEWIRE_PIN
        int "1-WIRE пин данных"
        default 27
        help
            1-WIRE пин данных

endmenu
```

## components/adc/Kconfig.projbuild
```kconfig
# ADC
menu "UMNI аналоговые порты"
    config UMNI_NTC_1
        int "Канал NTC 1"
        default 0
    config UMNI_NTC_2
        int "Канал NTC 1"
        default 3
    config UMNI_ADC_1
        int "Канал ADC 1"
        default 6
    config UMNI_ADC_2
        int "Канал ADC 2"
        default 7
endmenu
```

## components/dio/Kconfig.projbuild
```kconfig
menu "UMNI PCF8574 OUTPUT"

config UMNI_DO_I2C_ADDR
    hex "Адрес PCF8574 (выход)"
    default 0x27
    help
        Адрес микросхемы PCF8574, которая используется как выходы. По умолчанию 0x27.
    
config UMNI_DO_CHAN_1
    int "DO индекс канала 1"
    default 0
    help
       Индекс регистра цифрового выхода для канала №1.

config UMNI_DO_CHAN_2
    int "DO индекс канала 2"
    default 1
    help
        Индекс регистра цифрового выхода для канала №2.

config UMNI_DO_CHAN_3
    int "DO индекс канала 3"
    default 2
    help
        Индекс регистра цифрового выхода для канала №3.
    
config UMNI_DO_CHAN_4
    int "DO индекс канала 4"
    default 3
    help
        Индекс регистра цифрового выхода для канала №4.
        
config UMNI_DO_CHAN_5
    int "DO индекс канала 5"
    default 4
    help
        Индекс регистра цифрового выхода для канала №5.

config UMNI_DO_CHAN_6
    int "DO индекс канала 6"
    default 5
    help
        Индекс регистра цифрового выхода для канала №6.

config UMNI_STAT_LED
    int "Индекс светодиода статуса"
    default 6
    help
        Индекс светодиода статуса.

config UMNI_ERR_LED
    int "Индекс светодиода ошибки"
    default 7
    help
        Индекс светодиода ошибки

endmenu

menu "UMNI PCF8574 INPUT"

    config UMNI_DI_I2C_ADDR
        hex "Адрес PCF8574 (вход)"
        default 0x26
        help
            Адрес микросхемы PCF8574, которая используется как входы. По умолчанию 0x26.

    config UMNI_DI_INT_PIN
        int "Пин прерываний от PCF8574"
        default 16
        help
            Пин, использующися для перехвата прерываний от PCF8574

    config UMNI_DI_CHAN_1
        int "DI индекс канала 1"
        default 0
        help
            Индекс регистра цифрового входа для канала №1.
    
    config UMNI_DI_CHAN_2
        int "DI индекс канала 2"
        default 1
        help
            Индекс регистра цифрового входа для канала №2.
    
    config UMNI_DI_CHAN_3
        int "DI индекс канала 3"
        default 2
        help
            Индекс регистра цифрового входа для канала №3.
        
    config UMNI_DI_CHAN_4
        int "DI индекс канала 4"
        default 3
        help
            Индекс регистра цифрового входа для канала №4.
            
    config UMNI_DI_CHAN_5
        int "DI индекс канала 5"
        default 4
        help
            Индекс регистра цифрового входа для канала №5.
    
    config UMNI_DI_CHAN_6
        int "DI индекс канала 6"
        default 5
        help
            Индекс регистра цифрового входа для канала №6.
    
    config UMNI_FN_BTN
        int "Индекс функциональной кнопки"
        default 6
        help
            Индекс светодиода статуса.
    
    config UMNI_CFG_INP
        int "Индекс канала входа в конфигурационный режима"
        default 7
        help
            Индекс канала входа в конфигурационный режима (перемычка)
    
endmenu
```

## components/nvs/Kconfig.projbuild
```kconfig
menu "UMNI NVS"

    config UMNI_NVS_HOSTNAME
        string "Имя хоста"
        default "umni-c-one.local"
        help
            Укажите имя хоста (используется для MDNS, NETIF служб).
            
    config UMNI_NVS_NTP_DEFAULT
        string "Адрес сервера времени"
        default "0.ru.pool.ntp.org"
        help
            Укажите адрес NTP сервера для синхронихации времени

endmenu
```

## components/ota/Kconfig.projbuild
```kconfig
menu "UMNI OTA"

    config UMNI_OTA_FW_CHECK_URL_STABLE
        string "Адрес проверки новой стабильной версии"
        default "https://umni.su/downloads/devices/umni-c1/stable/latest"
        help
            Адрес проверки новой стабильной версии (стабильная версия).
    
    config UMNI_OTA_FW_CHECK_URL_BETA
        string "Адрес проверки новой бета версии"
        default "https://umni.su/downloads/devices/umni-c1/beta/latest"
        help
            Адрес проверки новой бета версии (бета версия).
    
endmenu
```

## components/rf433/Kconfig.projbuild
```kconfig
menu "UMNI RF433"
            
    config UMNI_RF433_REC_PIN
        int "Пин приемника RF433"
        default 25
        help
            Укажите пин приемника RF433.

endmenu
```

## components/webserver/Kconfig.projbuild
```kconfig
menu "UMNI Webserver"

    choice UMNI_WEB_DEPLOY_MODE
        prompt "Website deploy mode"
        default UMNI_WEB_DEPLOY_SEMIHOST
        help
            Режим расположения веб-сайта.
            См. https://github.com/espressif/esp-idf/blob/master/examples/protocols/http_server/restful_server/README.md#about-deploy-mode
        config UMNI_WEB_DEPLOY_SEMIHOST
            bool "Semihost (JTAG is needed)"
            help
                Режим SEMIHOST (выбирать для разработки).
        config UMNI_WEB_DEPLOY_SD
            depends on IDF_TARGET_ESP32
            bool "SD card"
            help
                Файлы веб-сервера на SD карте.
        config UMNI_WEB_DEPLOY_SF
            bool "SPI Nor Flash"
            help
                Файлы в SPI Nor Flash.
    endchoice

    if UMNI_WEB_DEPLOY_SEMIHOST
        config UMNI_HOST_PATH_TO_MOUNT
            string "Абсолютный путь до папки блда (билд должен содержать подпапку www)"
            default "C:\\Develop\\Projects\\UMNI\\umni-frontend\\build"
            help
                Если используется SEMIHOST ESP32, нужно указать путь до файлов веб-сервера, который будет примонтирован к VFS.
                Только абсолютный путь.
    endif

    config UMNI_WEB_MOUNT_POINT
        string "Точка монтирования VFS (не указывать, если выбран SEMIHOST)"
        default "/www"
        help
            Укажите точку монирования VFS.
            
    config UMNI_WEB_MAX_CLIENTS
        int "Максимальное количество одновременных подключений"
        default 5
        help
            Укажите максимальное количество клиентов веб-сервера.

endmenu
```

## main/Kconfig.projbuild
```kconfig
# I2C
menu "UMNI шина i2c"
    config UMNI_I2C_SDA
        int "i2c SDA pin"
        default 21
        help
            GPIO SDA pin.
    config UMNI_I2C_SCL
        int "i2c SCL pin"
        default 22
        help
            GPIO SCL pin.
endmenu

# OPENTHERM
menu "UMNI адаптер Opentherm"
    config UMNI_OT_OUT
        int "Выходной сигнал с линии Opentherm"
        default 33
        help
            Выходной сигнал с линии Opentherm.
    config UMNI_OT_IN
        int "Входной сигнал с линии Opentherm"
        default 32
        help
            Входной сигнал с линии Opentherm.
endmenu

# SD card
menu "UMNI SD card"
    config UMNI_SD_CS
        int "SD-CS пин карты памяти"
        default 27

    config UMNI_SD_MOUNT_POINT
        string  "Точка монтирования SD карты"
        default "/sdcard"
endmenu

# Timings
menu "UMNI Timeouts"
    config UMNI_TASK_TIMEOUT_BASE
        int "Базовый интервал выполнения задачи или задержки"
        default 60000

        config UMNI_TASK_TIMEOUT_LONG
            int "Большой интервал выполнения задачи или задержки"
            default 300000
endmenu
```
